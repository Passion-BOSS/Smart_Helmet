## application/samples/Kconfig
```kconfig
#===============================================================================
# @brief    Kconfig file.
# Copyright (c) HiSilicon (Shanghai) Technologies Co., Ltd. 2023-2023. All rights reserved.
#===============================================================================
config ENABLE_BT_SAMPLE
    bool
    prompt "Enable the Sample of BT."
    default n
    depends on SAMPLE_ENABLE
    help
        This option means enable the sample of BT.

if ENABLE_BT_SAMPLE
osource "application/samples/bt/Kconfig"
endif

config ENABLE_PERIPHERAL_SAMPLE
    bool
    prompt "Enable the Sample of peripheral."
    default n
    depends on SAMPLE_ENABLE
    help
        This option means enable the sample of peripheral.

if ENABLE_PERIPHERAL_SAMPLE
osource "application/samples/peripheral/Kconfig"
endif

config ENABLE_WIFI_SAMPLE
    bool
    prompt "Enable the Sample of WIFI."
    default n
    depends on SAMPLE_ENABLE
    help
        This option means enable the sample of WIFI.

if ENABLE_WIFI_SAMPLE
osource "application/samples/wifi/Kconfig"
endif

config ENABLE_PRODUCTS_SAMPLE
    bool
    prompt "Enable the Sample of products."
    default n
    depends on SAMPLE_ENABLE
    help
        This option means enable the sample of products.

if ENABLE_PRODUCTS_SAMPLE
osource "application/samples/products/Kconfig"
endif

config ENABLE_RADAR_SAMPLE
    bool
    prompt "Enable the Sample of RADAR."
    default n
    depends on SAMPLE_ENABLE
    help
        This option means enable the sample of RADAR.

if ENABLE_RADAR_SAMPLE
osource "application/samples/radar/Kconfig"
endif

config ENABLE_NFC_SAMPLE
    bool
    prompt "Enable the Sample of NFC."
    default n
    depends on SAMPLE_ENABLE
    help
        This option means enable the sample of NFC.

if ENABLE_NFC_SAMPLE
osource "application/samples/nfc/Kconfig"
endif


config ENABLE_DRIVER_SAMPLE
    bool
    prompt "Enable the Sample of driver."
    default n
    depends on SAMPLE_ENABLE
    help
        This option means enable the sample of driver.

if ENABLE_DRIVER_SAMPLE
osource "application/samples/driver/Kconfig"
endif

config ENABLE_MAIN_SAMPLE
    bool "Enable the Sample of main."
    default n
    depends on SAMPLE_ENABLE
    help
        This option means enable the sample of main.

if ENABLE_MAIN_SAMPLE
osource "application/samples/main/Kconfig"
endif

config ENABLE_LOGIC_SAMPLE
    bool
    prompt "Enable the Sample of logic."
    default n
    depends on SAMPLE_ENABLE
    help
        This option means enable the sample of main.

if ENABLE_LOGIC_SAMPLE
osource "application/samples/logic/Kconfig"
endif
```

## application/samples/driver/Kconfig
```kconfig
#===============================================================================
# @brief    Kconfig file.
# Copyright (c) HiSilicon (Shanghai) Technologies Co., Ltd. 2023-2023. All rights reserved.
#===============================================================================

config DRIVER_SAMPLE_BUTTON

    bool "Support BUTTON Sample Driver."

    default n
    depends on ENABLE_DRIVER_SAMPLE
    help
        This option means support BUTTON Sample Driver.

if DRIVER_SAMPLE_BUTTON
menu "BUTTON Sample Driver Configuration"
    osource "application/samples/driver/button/Kconfig"
endmenu
endif

config DRIVER_SAMPLE_LED_PWM

    bool "Support LED PWM Sample Driver."
    default n
    depends on ENABLE_DRIVER_SAMPLE
    help
        This option means support LED PWM Sample Driver.

if DRIVER_SAMPLE_LED_PWM
menu "LED PWM Sample Driver Configuration"
    osource "application/samples/driver/led_pwm/Kconfig"
endmenu
endif

config DRIVER_SAMPLE_SERIAL1

   bool "Support SERIAL1 Sample Driver."
    default n
    depends on ENABLE_DRIVER_SAMPLE
    help
        This option means support SERIAL1 Sample Driver.

if DRIVER_SAMPLE_SERIAL1
menu "SERIAL1 Sample Driver Configuration"
    osource "application/samples/driver/serial1/Kconfig"
endmenu
endif
```

## application/samples/driver/button/Kconfig
```kconfig
#===============================================================================
# @brief    Kconfig file.
# Copyright (c) HiSilicon (Shanghai) Technologies Co., Ltd. 2024-2024. All rights reserved.
#===============================================================================
config ROLL_UP_PIN
    int
    prompt "Choose roll-up pin."
    default 0
config ROLL_DOWN_PIN
    int
    prompt "Choose roll-down pin."
    default 1
config PUSH_BUTTON_PIN
    int
    prompt "Choose push button pin."
    default 2
```

## application/samples/driver/led_pwm/Kconfig
```kconfig
#===============================================================================
# @brief    Kconfig file.
# Copyright (c) HiSilicon (Shanghai) Technologies Co., Ltd. 2024-2024. All rights reserved.
#===============================================================================
config LED_PWM_PIN
    int
    prompt "Choose pwm pin."
    default 4
config PWM_CHANNEL
    int
    prompt "Choose PWM Test Channel."
    depends on SAMPLE_SUPPORT_PWM
    default 4

config PWM_GROUP_ID
    int
    prompt "Choose PWM Test Group ID."
    depends on SAMPLE_SUPPORT_PWM && PWM_USING_V151
    default 0

config PWM_PIN_MODE
    int
    prompt "Choose PWM pin mode."
    default 1
    depends on SAMPLE_SUPPORT_PWM
```

## application/samples/driver/serial1/Kconfig
```kconfig
#===============================================================================
# @brief    Kconfig file.
# Copyright (c) HiSilicon (Shanghai) Technologies Co., Ltd. 2024-2024. All rights reserved.
#===============================================================================
config UART_BUS_ID
    int
    prompt "Choose UART bus id."
    depends on SAMPLE_SUPPORT_UART
    default 1

config UART1_TXD_PIN
    int
    prompt "Choose UART1 TXD pin."
    depends on SAMPLE_SUPPORT_UART
    default 17

config UART1_RXD_PIN
    int
    prompt "Choose UART1 RXD pin."
    depends on SAMPLE_SUPPORT_UART
    default 18


config UART1_SUPPORT_INT_MODE
    bool
    prompt "UART1 support interrupt mode."
    depends on SAMPLE_SUPPORT_UART
    default n

config UART1_TRANSFER_SIZE
    int
    prompt "Config UART1 transfer size."
    depends on SAMPLE_SUPPORT_UART
    default 64
```

## application/samples/logic/Kconfig
```kconfig
#===============================================================================
# @brief    Kconfig file.
# Copyright (c) HiSilicon (Shanghai) Technologies Co., Ltd. 2023-2023. All rights reserved.
#===============================================================================

config SAMPLE_LOGIC_GASSENSOR
    bool"Support logic gassensor."
    depends on ENABLE_LOGIC_SAMPLE
    help
        This option means support logic gassensor.

if SAMPLE_LOGIC_GASSENSOR
menu "Gassensor Configuration"
    osource "application/samples/logic/gassensor/Kconfig"
endmenu
endif

config SAMPLE_LOGIC_FLASHLIGHT
    bool "Support logic flashlight."
    depends on ENABLE_LOGIC_SAMPLE
    help
        This option means support logic flashlight.

if SAMPLE_LOGIC_FLASHLIGHT
menu "Flashlight Configuration"
    osource "application/samples/logic/flashlight/Kconfig"
endmenu
endif
config SAMPLE_LOGIC_HALLSENSOR
   bool "Support logic hallsensor."
    depends on ENABLE_LOGIC_SAMPLE
    help
        This option means support logic hallsensor.

if SAMPLE_LOGIC_HALLSENSOR
menu "Hallsensor Configuration"
    osource "application/samples/logic/hallsensor/Kconfig"
endmenu
endif
  
```

## application/samples/logic/flashlight/KConfig
```kconfig
config FLASHLIGHT_ENABLE
    bool "Enable flashlight functionality"
    default y
    help
        Enable the flashlight feature. This includes PWM control for brightness
        and key handling for user interaction.

config FLASHLIGHT_DEFAULT_BRIGHTNESS
    int "Default brightness level (0-100)"
    range 0 100
    default 50
    help
        Set the default brightness level when flashlight is turned on.

config FLASHLIGHT_STORAGE_SUPPORT
    bool "Enable brightness settings storage"
    default y
    help
        Save and restore brightness settings using non-volatile storage.
```

## application/samples/logic/gassensor/Kconfig
```kconfig
config ENABLE_GASSENSOR_LOGIC
    prompt "Enable the Gas Sensor Logic."
    bool
    default n
    help
        This option enables the Gas Sensor Logic.        
```

## application/samples/logic/hallsensor/Kconfig
```kconfig
config HALL_SENSOR_PIN
    int "hall sensor pin"
    default 5
    help
      This is the pin number of the hall sensor.
```

## application/samples/main/Kconfig
```kconfig
#===============================================================================
# @brief    Kconfig file.
# Copyright (c) HiSilicon (Shanghai) Technologies Co., Ltd. 2023-2023. All rights reserved.
#===============================================================================
config SAMPLE_MAIN_TASK1_LED
   bool"Suppose sample main task1 led."
    depends on ENABLE_MAIN_SAMPLE
    help
        This option means support sample main task1 led.

if SAMPLE_MAIN_TASK1_LED
menu "Task1 LED Configuration"
    osource "application/samples/main/task1_led/Kconfig"
    endmenu
endif

config SAMPLE_MAIN_TASK2_GASSENSOR
   bool"Support sample main task2 gassensor."
    depends on ENABLE_MAIN_SAMPLE
    help
        This option means support sample main task2 gassensor.

if SAMPLE_MAIN_TASK2_GASSENSOR
menu "Task2 Gassensor Configuration"
    osource "application/samples/main/task2_gassensor/Kconfig"
    endmenu
endif

config SAMPLE_MAIN_TASK3_HALLSENSOR
   bool"Support sample main task3 hallsensor."
    depends on ENABLE_MAIN_SAMPLE
    help
        This option means support sample main task3 hallsensor.

if SAMPLE_MAIN_TASK3_HALLSENSOR
menu "Task3 Hallsensor Configuration"
    osource "application/samples/main/task3_hallsensor/Kconfig"
    endmenu
endif
   
```

## application/samples/main/task1_led/Kconfig
```kconfig
config ENABLE_TASK1_LED_SAMPLE
    bool
    prompt "Enable the Sample of Task1 LED."
    default n
    depends on SAMPLE_ENABLE
    help
        This option means enable the sample of Task1 LED.
    
```

## application/samples/main/task2_gassensor/Kconfig
```kconfig
config ENABLE_TASK2_GASSENSOR_SAMPLE
    bool
    prompt "Enable the Sample of Task2 Gas Sensor."
    default n
    depends on SAMPLE_ENABLE
    help
        This option means enable the sample of Task2 Gas Sensor.
    
```

## application/samples/main/task3_hallsensor/Kconfig
```kconfig
config ENABLE_TASK3_HALSENSOR_SAMPLE
    bool
    prompt "Enable the Sample of Task3 Hal Sensor."
    default n
    depends on SAMPLE_ENABLE
    help
        This option means enable the sample of Task3 Hall Sensor.
    
```
